/********************************************************************/
// - Данный скетч демонстрирует работу ЭЭГ сенсора, пожключенного к порту А0 Ардуино.
// - Параметры скетча подобраны для регистрации альфа -ритма (8-14 Гц). В случае большого числа ложных срабатываний, или наоборот, трудностями с запуском
// рекомендуется менять только параметрaThreashold
// - Для управление альфа ратимом используется 11 вывод Ардуино
// - Для индикации плохого контакта электродов с поверхностью головы используется вывод 3 Ардуино
/********************************************************************/


#include <fft.h>
#define num 256              // Количество анализируемых точек, НЕ МЕНЯТЬ!

#define aThreashold 4.2        // ВНИМАНИЕ: здесь задаем порога сравнения альфа ритма!

int8_t im[num], data[num];
int i=0, val;

int sped = 0;                // Переменная для скорости вращения

bool fail = false;          // Флаг, регестрирующий зашкаливание/плохой контакт электродов

void printSpectr(int8_t*, int8_t*);    // Отладочная функция для вывода спектр а программу анализатора.
  
void setup() {
    Serial.begin(115200);
    pinMode(11,OUTPUT);         // Пин управления вентилятором
    pinMode(3,OUTPUT);          // Диод, сигнализирующий о плохом контакте
}

void loop() {
  
  int8_t sum = 0;
  // Заполняем массив значениями АЦП сигнала. Деления на 8 надо для корректной работы либы FFT. Сравнение с окном [2;120] для регистрации зашкала.
  for (i=0; i < num; i++){                                     
    data[i] = analogRead(0)/8;  
    
    Serial.write("A0");    // Отправляем название порта, к которому подключен ЭЭГ (для визуализатора)
    Serial.write(data[i]);  // Отправляем оцифрованное значение
    
    // Если значение АЦП выходит за пределы - фиксируем зашкаливание - плохой контакт электродов
    if (data[i] < 2 || data[i] > 120){
      fail = true;
    }
   
    delay(2);    // Задержка 2мс
    im[i] = 0;   // Заполняем нулями вспомогательный массив для преобразования Фурье                                            
    sum = sum+data[i];  // Вычисляем сумму значений АЦП в анализируемом окне (для вычисления средней величины - смещение сигнала по постоянному напряжению)
  }
 
 // Если нет зашкаливания, гасим диод и начинаем считать спектр
 if (!fail){
   digitalWrite(3,LOW);
   
   // Вычитаем постоянную составляющую сигнала
   for (i=0; i < num; i++){                                     
     data[i] = data[i] - sum/num;
   }
    
   // Считаем спектр сигнала
   fix_fft(data,im,8,0);
   //printSpectr(data,im);
   
   // Флаг наличия альфа ритма
   bool flag = false;
    
    // Смотрим в спектре на альфа составлящую. Частоты альфа ритма соотвтествуют окну значений [6;15] в возвращаемом спектре
    for (i=6; i<15; i++){ 
      if( sqrt(data[i]*data[i] + im[i]*im[i]) > aThreashold){           
        flag = true;
      }
    }
    
    // Если нет альфа ритма- плавно в две итерации уменьшаем напряжение на выводе
    if (!flag){
      if (sped != 0){
        sped = sped - 75;
      }
    }
    
    // Если есть альфа ритм - подаем полное напряжение на выход
    if(flag){
       sped = 150;
       flag = false; 
    }
    
    // Запись значния напряжения на выход
    analogWrite(11,sped);
      
 }
 else{
   digitalWrite(3,HIGH);
   digitalWrite(11,LOW);
 }
 
 fail = false;
}

// Вспомогательная функция для отладки
void printSpectr(int8_t* re, int8_t* im){
  int j = 0;
  for(j = 0; j < num; j++){
    Serial.write("A1");
    Serial.write(5 * (uint8_t)sqrt(re[j]*re[j] + im[j]*im[j]));
  }
  
  for(j=0; j < 100; j++){
    Serial.write("A1");
    Serial.write(0);
  }
}

const uint8_t   pinSensor = A3;       //  Определяем константу с номером вывода к которому подключён датчик звука
const uint16_t  varVolume = 800;      //  Определяем константу с уровнем громкости сигнала      (принимаются только те сигналы, громкость которых выше указанного уровня)
const uint32_t  tmrSignal = 300;      //  Определяем константу с указанием длительности сигнала (если сигнал короче - точка, если сигнал длиннее - тире)
const uint32_t  tmrPause  = 500;      //  Определяем константу с указанием длительности паузы   (если пауза между сигналами дольше, значит начинается новое слово)
      uint32_t  tmrSeparator;         //  Объявляем переменную для определения граничного времени для сигналов и пауз
      uint8_t   varLetter;            //  Объявляем переменную для хранения принятых точек и тире одного символа (бит 0 - точка, бит 1 - тире)
      uint8_t   lenLetter;            //  Объявляем переменную для хранения количества точек и тире в принятом символе
      bool      flgSignal;            //  Объявляем флаг указывающий на то что была принята хотя бы одна точка или тире
      bool      flgLetter;            //  Объявляем флаг указывающий на то что был принят символ
      char      chrMorze[] = {'A', 'B', 'C', 'D', 'E', 'F', 'G', 'H', 'I', 'J', 'K', 'L', 'M', 'N', 'O', 'P', 'Q', 'R', 'S', 'T', 'U', 'V', 'W', 'X', 'Y', 'Z', '1', '2', '3', '4', '5',  '6',  '7',  '8',  '9',  '0',  '.',  ';',  ',',  ':',  '?',  '!',  '-',  ' ', '\n', '\r'};
      uint8_t   lenMorze[] = {  2,   4,   4,   3,   1,   4,   3,   4,   2,   4,   3,   4,   2,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    5,    5};
      uint8_t   varMorze[] = {0x1, 0x8, 0xA, 0x4, 0x0, 0x2, 0x6, 0x0, 0x0, 0x7, 0x5, 0x4, 0x3,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 0x15, 0x0A};
                                                                                      // Массивы: chrMorze - содержит символы, lenMorze - количество точек и тире в символе, varMorze - комбинация точек и тире (бит 0 - точка, бит 1 - тире)
void setup(){                                                                         //
    flgLetter=varLetter=lenLetter=0;                                                  // Сбрасываем флаги и переменные относящиеся к принятому символу
    Serial.begin(9600);                                                               // Инициируем передачу данных в монитор последовательного порта на скорости 9600 бит/сек
    Serial.println("Детектор азбуки Морзе");                                          // Выводим текст "Детектор азбуки Морзе"
    Serial.println("=====================");                                          // Выводим текст "====================="
}                                                                                     //
                                                                                      //
void loop(){                                                                          //
//  Если зафиксирован звук:                                                           //
    if(analogRead(pinSensor) > varVolume){                                            // Если уровень звука считанный со входа pinSensor превышает значение varVolume
        flgSignal=true;                                                               // Устанавливаем флаг указывающий на наличие сигнала
        lenLetter++;                                                                  // Увеличиваем счетчик количества точек и тире в принятом символе
        tmrSeparator = millis()+tmrSignal;                                            // Определяем граничное время сигнала (если сигнал пропадёт до этого времени - значит принята точка, иначе принято тире)
        while(analogRead(pinSensor) > varVolume){delay(10);}                          // Ждём пока не пропадёт сигнал
        varLetter<<=1; varLetter|=tmrSeparator<millis();                              // Сдвигаем все биты переменной varLetter (она хранит принятые точки и тире символа) и записываем в последний бит этой переменной «0» или «1» (зависит от длительности сигнала)
//  Если зафиксирована пауза:                                                         //
    }else{                                                                            // Если уровень звука считанный со входа pinSensor меньше или равен значению varVolume (считаем что это пауза)
        tmrSeparator = millis()+tmrPause;                                             // Определяем граничное время паузы (если пауза пропадёт до этого времени - значит мы продолжаем принимать символ, иначе символ полностью принят)
        while(analogRead(pinSensor) < varVolume && tmrSeparator>millis()){delay(10);} // Ждём пока не исчезнет пауза, но не дольше чем время указанное в tmrSeparator
        if(tmrSeparator<millis()){flgLetter=flgSignal; flgSignal=false;}              // Если пауза длилась дольше чем указано в tmrSeparator, то устанавливаем флаг flgLetter, но только если установлен флаг flgSignal указывающий что ранее был принят хотя бы один сигнал
    }                                                                                 //
//  Если принят символ:                                                               //
    if(flgLetter){                                                                    // Если установлен флаг flgLetter значит символ полностью принят, его нужно сравнить и вывести
        for(uint8_t i=0; i<46; i++){                                                  // Проходим по всем 46 символам массивов
        if(varLetter==varMorze[i] && lenLetter==lenMorze[i]){                         // Если комбинация точек и тире в varLetter совпала с varMorze[i] и количество точек и тире совпало с lenMorze[i], то...
            Serial.print(chrMorze[i]);                                                // Выводим символ из chrMorze[i] в монитор последовательного порта
        }}  flgLetter=varLetter=lenLetter=0;                                          // Сбрасываем флаги и переменные относящиеся к принятому символу, так как мы его уже вывели
    }                                                                                 //
}                                                                                     //
